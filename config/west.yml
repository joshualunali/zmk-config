## config/west.yml
```yaml
# manifest:
#   defaults:
#     revision: v0.3
#   remotes:
#     - name: zmkfirmware
#       url-base: https://github.com/zmkfirmware
#     # Additional modules containing boards/shields/custom code can be listed here as well
#     # See https://docs.zephyrproject.org/3.2.0/develop/west/manifest.html#projects
#   projects:
#     - name: zmk
#       remote: zmkfirmware
#       revision: v0.3.0
#       import: app/west.yml
#   self:
#     path: config

manifest:
  remotes:
    - name: zmkfirmware
      url-base: https://github.com/zmkfirmware
    # support nice_oled and nice_epaper
    - name: joshualunali
      url-base: https://github.com/joshualunali
  projects:
    - name: zmk
      remote: zmkfirmware
      revision: v0.3.0
      import: app/west.yml
    # support nice_oled and nice_epaper
    - name: zmk-nice-oled
      remote: joshualunali
      revision: main
  self:
    path: config
# manifest:
#   remotes:
#     - name: zmkfirmware
#       url-base: https://github.com/zmkfirmware
#     - name: infely                             # new entry
#       url-base: https://github.com/infely      # new entry
#   projects:
#     - name: zmk
#       remote: zmkfirmware
#       revision: main
#       import: app/west.yml
#     - name: nice-view-battery                  # new entry
#       remote: infely                           # new entry
#       revision: main                           # new entry
#   self:
#     path: config
```
